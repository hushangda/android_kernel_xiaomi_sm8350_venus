## drivers/android/Kconfig
```kconfig
# SPDX-License-Identifier: GPL-2.0
menu "Android"

config ANDROID
	bool "Android Drivers"
	---help---
	  Enable support for various drivers needed on the Android platform

if ANDROID

config ANDROID_BINDER_IPC
	bool "Android Binder IPC Driver"
	depends on MMU
	default n
	---help---
	  Binder is used in Android for both communication between processes,
	  and remote method invocation.

	  This means one Android process can call a method/routine in another
	  Android process, using Binder to identify, invoke and pass arguments
	  between said processes.

config ANDROID_BINDERFS
	bool "Android Binderfs filesystem"
	depends on ANDROID_BINDER_IPC
	default n
	---help---
	  Binderfs is a pseudo-filesystem for the Android Binder IPC driver
	  which can be mounted per-ipc namespace allowing to run multiple
	  instances of Android.
	  Each binderfs mount initially only contains a binder-control device.
	  It can be used to dynamically allocate new binder IPC devices via
	  ioctls.

config ANDROID_BINDER_DEVICES
	string "Android Binder devices"
	depends on ANDROID_BINDER_IPC
	default "binder,hwbinder,vndbinder"
	---help---
	  Default value for the binder.devices parameter.

	  The binder.devices parameter is a comma-separated list of strings
	  that specifies the names of the binder device nodes that will be
	  created. Each binder device has its own context manager, and is
	  therefore logically separated from the other devices.

config ANDROID_BINDER_IPC_SELFTEST
	bool "Android Binder IPC Driver Selftest"
	depends on ANDROID_BINDER_IPC
	---help---
	  This feature allows binder selftest to run.

	  Binder selftest checks the allocation and free of binder buffers
	  exhaustively with combinations of various buffer sizes and
	  alignments.

config ANDROID_VENDOR_HOOKS
	bool "Android Vendor Hooks"
	depends on TRACEPOINTS
	---help---
	  Enable vendor hooks implemented as tracepoints

	  Allow vendor modules to attach to tracepoint "hooks" defined via
	  DECLARE_HOOK or DECLARE_RESTRICTED_HOOK.

config ANDROID_VENDOR_FREEZER_COMPAT
	bool
	depends on NET && SYSFS
	default n
	help
	  Own raw-netlink protocol 29 and route the first valid userspace
	  handshake to either the OPlus HANS or Xiaomi MILLET backend.

config OPLUS_FEATURE_HANS
	bool "OPlus HANS freezer compatibility"
	depends on ANDROID_BINDER_IPC
	depends on ANDROID_VENDOR_HOOKS
	depends on NETFILTER && INET
	select ANDROID_VENDOR_FREEZER_COMPAT
	default n
	help
	  Provide the raw-netlink, Binder, signal and network callbacks
	  expected by the OPlus HANS userspace freezer service.

config OPLUS_FEATURE_LINKPOWER
	bool "OPlus LinkPower network compatibility"
	depends on INET
	depends on NETFILTER
	default n
	help
	  Provide the linkpower generic-netlink ABI and socket accounting used by
	  the OPlus network-power framework. This includes per-process socket
	  ownership, connection statistics, socket teardown and the socket mark
	  consumed by OPlus netd's netdisable BPF programs.

config OPLUS_FEATURE_STABILITY_HELPER
	bool "OPlus framework stability compatibility"
	depends on ANDROID_BINDER_IPC
	depends on TRACEPOINTS
	depends on DMA_SHARED_BUFFER
	default n
	help
	  Provide the oplus_frk_nl generic-netlink ABI expected by the OPlus
	  system server and report excessive thread creation, low-memory causes
	  and long-pending asynchronous Binder transactions.

endif # if ANDROID

endmenu
```

## drivers/mihw/Kconfig
```kconfig
config MILLET
	bool "frozen framework"
	default y
	depends on MIHW && ANDROID && NET && SYSFS
	select ANDROID_VENDOR_FREEZER_COMPAT
	---help---
	  Mi frozen function
```
